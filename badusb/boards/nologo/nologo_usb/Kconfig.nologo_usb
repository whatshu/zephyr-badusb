## badusb/boards/nologo/nologo_usb/Kconfig.nologo_usb
```kconfig
# SPDX-License-Identifier: Apache-2.0

config BOARD_NOLOGO_USB
	select SOC_RP2040
```

## badusb/boards/nologo/nologo_usb/board.yml
```yaml
# SPDX-License-Identifier: Apache-2.0
# nologo_usb board definition based on Raspberry Pi Pico (RP2040)

board:
  name: nologo_usb
  full_name: NoLogo USB Device (RP2040)
  vendor: nologo
  socs:
    - name: rp2040
```

## badusb/boards/nologo/nologo_usb2/Kconfig.defconfig
```kconfig
# SPDX-License-Identifier: Apache-2.0

if BOARD_NOLOGO_USB2

config USB_SELF_POWERED
	default n

endif # BOARD_NOLOGO_USB2
```

## badusb/boards/nologo/nologo_usb2/board.yml
```yaml
# SPDX-License-Identifier: Apache-2.0

board:
  name: nologo_usb2
  full_name: NoLogo USB Device 2 (RP2350)
  vendor: nologo
  socs:
    - name: rp2350a
```
